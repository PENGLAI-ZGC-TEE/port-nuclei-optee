## conf/xiangshansoc/linux_rv64imafdc_defconfig
```kconfig
# platform
CONFIG_DEFAULT_HOSTNAME="xiangshan"

# kernel parameters
#CONFIG_SMP=y
#CONFIG_HOTPLUG_CPU=y
CONFIG_HZ_100=y
CONFIG_ARCH_RV64I=y
CONFIG_CMDLINE="earlyprintk"
CONFIG_SYSVIPC=y
CONFIG_CGROUPS=y
CONFIG_NAMESPACES=y
CONFIG_USER_NS=y
CONFIG_EXPERT=y
CONFIG_MODULES=y
CONFIG_MODULE_UNLOAD=y
CONFIG_MODVERSIONS=y
CONFIG_FUTEX=y

# RAM filesystem/disk
CONFIG_BLK_DEV_INITRD=y

#########
# debug #
#########
CONFIG_DEBUG_INFO=y
CONFIG_DEBUG_INFO_DWARF_TOOLCHAIN_DEFAULT=y
CONFIG_CONSOLE_LOGLEVEL_DEFAULT=8
CONFIG_PRINTK_TIME=y
CONFIG_GDB_SCRIPTS=y

# net
#CONFIG_NET=y
#CONFIG_NETFILTER=y
#CONFIG_NETLINK_DIAG=y
#CONFIG_PACKET=y
#CONFIG_UNIX=y
#CONFIG_UNIX_DIAG=y
#CONFIG_TLS=y
#CONFIG_INET=y
#CONFIG_IP_MULTICAST=y
#CONFIG_IP_ADVANCED_ROUTER=y
#CONFIG_IP_PNP=y
#CONFIG_IP_PNP_DHCP=y
#CONFIG_IP_PNP_BOOTP=y
#CONFIG_IP_PNP_RARP=y
#CONFIG_NET_IPIP=y
#CONFIG_INET_AH=y
#CONFIG_INET_ESP=y
#CONFIG_INET_ESPINTCP=y
#CONFIG_INET_IPCOMP=y
#CONFIG_INET_UDP_DIAG=y
#CONFIG_INET_RAW_DIAG=y
#CONFIG_TCP_CONG_ADVANCED=y
#CONFIG_TCP_CONG_BIC=y
#CONFIG_TCP_CONG_WESTWOOD=y
#CONFIG_TCP_CONG_HTCP=y
#CONFIG_IPV6_ROUTER_PREF=y
#CONFIG_IPV6_ROUTE_INFO=y

# device
CONFIG_DEVTMPFS=y
CONFIG_DEVTMPFS_MOUNT=y
CONFIG_MTD=y
CONFIG_MTD_TESTS=m
CONFIG_MTD_CMDLINE_PARTS=y
CONFIG_MTD_BLOCK=y
CONFIG_FTL=y
CONFIG_MTD_CFI=y
CONFIG_MTD_SPI_NOR=m
CONFIG_OF_OVERLAY=y
CONFIG_BLK_DEV_LOOP=y
CONFIG_BLK_DEV_RAM=y
#CONFIG_NETDEVICES=y
#CONFIG_PCIE_XDMA_PL_RV=y


##########
# serial #
########## 
CONFIG_SERIAL_EARLYCON_RISCV_SBI=y
# use only one UART now: 16550a
CONFIG_SERIAL_8250=y
CONFIG_SERIAL_8250_CONSOLE=y
CONFIG_SERIAL_8250_NR_UARTS=1
CONFIG_SERIAL_8250_RUNTIME_UARTS=1
CONFIG_SERIAL_OF_PLATFORM=y
CONFIG_VIRTIO_CONSOLE=y
CONFIG_HVC_RISCV_SBI=y

########
# PLIC #
########
CONFIG_SIFIVE_PLIC=y


#######
# SPI #
#######
#CONFIG_SPI=y
#CONFIG_SPI_DEBUG=y
#CONFIG_SPI_CADENCE_QUADSPI=m
#CONFIG_SPI_SPIDEV=y
#CONFIG_SPI_SLAVE=y

#######
# MMC #
#######
#CONFIG_MMC=y
#CONFIG_MMC_SDHCI=y
#CONFIG_MMC_SDHCI_PLTFM=y
#CONFIG_MMC_SDHCI_OF_DWCMSHC=y


#######
# TEE #
#######
CONFIG_TEE=y
CONFIG_OPTEE=y

###############
# File System #
###############
CONFIG_EXT3_FS=y
CONFIG_JFS_FS=y
CONFIG_F2FS_FS=y
CONFIG_AUTOFS_FS=y
CONFIG_MSDOS_FS=y
CONFIG_VFAT_FS=y
CONFIG_EXFAT_FS=y
CONFIG_TMPFS=y
CONFIG_TMPFS_POSIX_ACL=y
CONFIG_EFIVAR_FS=y
CONFIG_JFFS2_FS=y
CONFIG_NFS_FS=y
CONFIG_NLS_CODEPAGE_437=y
CONFIG_NLS_ISO8859_1=y

CONFIG_INITRAMFS_SOURCE="initramfs.cpio.gz"

################
# cryptography #
################
CONFIG_CRYPTO_USER=y
CONFIG_CRYPTO_USER_API_HASH=y


# GPU
CONFIG_DRM_RADEON=m
CONFIG_DRM_RADEON_USERPTR=y
CONFIG_DRM_AMDGPU=m

CONFIG_HID_GENERIC=y
CONFIG_USB_SUPPORT=y
CONFIG_USB=y
CONFIG_USB_ANNOUNCE_NEW_DEVICES=y
CONFIG_USB_XHCI_HCD=y
CONFIG_USB_STORAGE=y
CONFIG_INPUT_EVDEV=y
CONFIG_R8169=y
CONFIG_USB_ANNOUNCE_NEW_DEVICES=y
CONFIG_USB_STORAGE=y

CONFIG_CMA=y
CONFIG_CMA_DEBUG=y
CONFIG_DMA_CMA=y
CONFIG_DMA_PERNUMA_CMA=y
CONFIG_USB_USBNET=y
CONFIG_USB_NET_CDC_MBIM=y
CONFIG_BLK_DEV_SD=y
CONFIG_CHR_DEV_SG=y
CONFIG_GPIOLIB=y
CONFIG_DEBUG_GPIO=y
CONFIG_GPIO_SYSFS=y
CONFIG_GPIO_DWAPB=y
CONFIG_WATCHDOG=y
# CONFIG_WATCHDOG_HANDLE_BOOT_ENABLED is not set
CONFIG_DW_WATCHDOG=y
CONFIG_EEPROM_AT24=y
CONFIG_I2C_CHARDEV=y
CONFIG_I2C_DESIGNWARE_PLATFORM=y

CONFIG_IGB=y
CONFIG_BLK_DEV_NVME=y
CONFIG_RTL8152=y
CONFIG_RISCV_SBI_V01=y

CONFIG_PHYSICAL_START=0x81000000
CONFIG_DEBUG_KERNEL=y
```
